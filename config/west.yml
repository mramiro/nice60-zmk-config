## config/west.yml
```yaml
manifest:
  remotes:
    - name: zmkfirmware
      url-base: https://github.com/zmkfirmware
  projects:
    - name: zmk
      remote: zmkfirmware
      revision: f72f415c5bd23a89d7e50b1a8e22ede70c0db9e3
      import: app/west.yml
  self:
    path: config
```
